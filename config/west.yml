## config/west.yml
```yaml
manifest:
  remotes:
    - name: zmkfirmware
      url-base: https://github.com/zmkfirmware
    - name: MangoIV      
      url-base: https://github.com/MangoIV
  projects:
    - name: zmk
      remote: MangoIV
      revision: main
      import: app/west.yml
  self:
    path: config
```
